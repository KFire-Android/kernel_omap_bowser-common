## arch/arm/configs/android_tate_defconfig
```kconfig
# CONFIG_KERNEL_GZIP is not set
CONFIG_KERNEL_LZMA=y
CONFIG_RD_BZIP2=y
CONFIG_RD_LZMA=y
CONFIG_CC_OPTIMIZE_FOR_SIZE=y
CONFIG_MACH_OMAP4_BOWSER_SUBTYPE_TATE=y
CONFIG_USE_AMAZON_DUCATI=y
CONFIG_DDR_CHIP_SELECT_1=y
CONFIG_CMDLINE="mem=1G rootdelay=2 androidboot.console=ttyO2 androidboot.hardware=bowser androidboot.selinux=permissive"
# CONFIG_CMDLINE_EXTEND is not set
CONFIG_CMDLINE_FORCE=y

# CONFIG_BT_BNEP_MC_FILTER is not set
# CONFIG_BT_BNEP_PROTO_FILTER is not set
CONFIG_BT_HCIUART=y
CONFIG_BT_HCIUART_H4=y
CONFIG_BT_HCIUART_H5=y

CONFIG_CFG80211=y
# CONFIG_MAC80211 is not set
CONFIG_RFKILL_INPUT=y

CONFIG_BCMDHD=m
CONFIG_BCMDHD_FW_PATH="system/vendor/firmware/fw_bcmdhd.bin"
CONFIG_BCMDHD_NVRAM_PATH="/system/etc/wifi/bcmdhd.cal"

# CONFIG_KEYBOARD_ATKBD is not set
CONFIG_KEYBOARD_GPIO=y
CONFIG_KEYBOARD_CEC=y
CONFIG_TOUCHSCREEN_ATMEL_MXT=m
CONFIG_INPUT_MAX44007=y
CONFIG_INPUT_MAX44007_HYSTERESIS=20
CONFIG_INPUT_BU52061_HALLSENSOR=y
CONFIG_I2C_GPIO=y
CONFIG_GPIO_SYSFS=y
CONFIG_BATTERY_BQ27541=y
CONFIG_CHARGER_SMB347=y
CONFIG_TWL6030_GPADC=y

CONFIG_HDMI_TI_4XXX_IP=y
CONFIG_FB_OMAP_BOOTLOADER_INIT=y
CONFIG_OMAP4_DSS_HDMI=y
CONFIG_PANEL_NT51012_LG=y
CONFIG_OMAP4_HDCP=y
CONFIG_OMAP4_HDCP_DEBUG=y
CONFIG_BACKLIGHT_LP855X=y

CONFIG_SND_DRIVERS=y
CONFIG_SND_OMAP_SOC_ABE_DSP=y
CONFIG_SND_OMAP_SOC_MCBSP=y
CONFIG_SND_OMAP_SOC_ABE=y
CONFIG_SND_OMAP_SOC_HDMI=y
CONFIG_SND_OMAP_SOC_BOWSER=y
CONFIG_SND_OMAP_SOC_OMAP4_HDMI=y
CONFIG_SND_OMAP4_ABE_USE_ALT_FW=y
CONFIG_SND_SOC_OMAP_HDMI_CODEC=y
CONFIG_SND_SOC_WM8962=y

# CONFIG_NOP_USB_XCEIV is not set

CONFIG_LEDS_PWM=y

CONFIG_IIO=y
CONFIG_IIO_BUFFER=y
CONFIG_IIO_KFIFO_BUF=y
CONFIG_IIO_TRIGGER=y
CONFIG_IIO_CONSUMERS_PER_TRIGGER=2
CONFIG_INV_MPU_IIO=y

CONFIG_OMAP_TEMP_SENSOR=y
CONFIG_OMAP4_DIE_TEMP_SENSOR=y
CONFIG_OMAP4_TMP103_SENSOR=y

CONFIG_DECOMPRESS_BZIP2=y
CONFIG_DECOMPRESS_LZMA=y
CONFIG_AVERAGE=y
```

## drivers/staging/trapz/Kconfig
```kconfig
config TRAPZ
	bool "Tracing and Profiling for Zpeed"
	default n

config TRAPZ_DETAIL
	bool "Include cpu and pid/tid in trace log"
	default n
	depends on TRAPZ

config TRAPZ_LED
	bool "Support usage of debug LEDs"
	default n
	depends on TRAPZ
	help
		This should only be defined for targets that have debug LEDs
		available and have the correct trapz platform device
		defined.

config TRAPZ_PERF
	bool "Support starting/stoping perf tool from TRAPZ framework"
	default n
	depends on TRAPZ && DEBUG_FS
	help
		This feature should only be defined if DEBUG_FS is supported. This feature
		also has functional dependencies on PMU support and perf tool.
```
